## drivers/contactless/new-pn532/Kconfig
```kconfig
if CL_NEW_PN532

config CL_NEW_PN532_SPI_FREQ
  int "PN532 SPI frequency in Hz"
  default 1000000
  depends on CL_NEW_PN532

endif # CL_NEW_PN532
```

## drivers/wireless/lpwan/sx126x/Kconfig
```kconfig
#
# For a description of the syntax of this configuration file,
# see the file kconfig-language.txt in the NuttX tools repository.
#

if LPWAN_SX126X

config LPWAN_SX126X_RFFREQ_DEFAULT
	int "SX126X default RF frequency"
	default 868000000

config LPWAN_SX126X_MAX_DEVICES
	int "SX126X maximum devices"
	default 1

endif # DRIVERS_LPWAN
```
